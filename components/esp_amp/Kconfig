## components/esp_amp/Kconfig
```kconfig
menu "ESP Asymmetric Multi-Processing(AMP) Framework"

    config ESP_AMP_ENABLED
        depends on (IDF_TARGET_ESP32C6 || IDF_TARGET_ESP32C5 || IDF_TARGET_ESP32P4)
        bool "Enable ESP Asymmetric Multi-Processing(AMP) framework"
        default "n"
        help
            Enable this feature if you plan to use ESP-AMP framework

    choice ESP_AMP_SUBCORE_TYPE
        prompt "ESP AMP subcore type"
        depends on ESP_AMP_ENABLED
        default ESP_AMP_SUBCORE_TYPE_LP_CORE if IDF_TARGET_ESP32C6 || IDF_TARGET_ESP32C5
        default ESP_AMP_SUBCORE_TYPE_HP_CORE if IDF_TARGET_ESP32P4
        help
            Choose the ESP AMP SubCore type: HP core or LP core

        config ESP_AMP_SUBCORE_TYPE_LP_CORE
            bool "LP Core"
            depends on IDF_TARGET_ESP32C6 || IDF_TARGET_ESP32C5
            depends on SOC_LP_CORE_SUPPORTED

        config ESP_AMP_SUBCORE_TYPE_HP_CORE
            bool "HP Core"
            depends on IDF_TARGET_ESP32P4
            select FREERTOS_UNICORE
    endchoice

    menu "ESP-AMP Memory Management"
        depends on ESP_AMP_ENABLED

        config ESP_AMP_HP_SHARED_MEM_SIZE
            int "Size of shared memory (from HP RAM) accessible by maincore and subcore"
            default 16384 if IDF_TARGET_ESP32C6 || IDF_TARGET_ESP32C5
            default 16384 if IDF_TARGET_ESP32P4
            range 1024 20480 if IDF_TARGET_ESP32C6 || IDF_TARGET_ESP32C5
            range 1024 65536 if IDF_TARGET_ESP32P4
            help
                Configure the size of shared memory (from HP RAM) accessible by maincore
                and subcore.

                ESP-AMP components internally allocate buffer from this shared memory,
                such as virtqueue buffers, event and software interrupt bits. Make sure
                the size is large enough. Application can also allocate buffer from this
                shared memory using SysInfo API.

        config ESP_AMP_RTC_SHARED_MEM_SIZE
            int "Size of shared memory (from RTC RAM) accessible by maincore and subcore"
            depends on ESP_AMP_SUBCORE_TYPE_LP_CORE
            default 256
            range 2 1024
            help
                Configure the size of shared memory (from RTC RAM) accessible by maincore
                and subcore. Different from HP RAM, RTC RAM is accessible during light
                sleep.

                ESP-AMP components internally allocate buffer from this shared memory,
                such as virtqueue buffers, event and software interrupt bits. Make sure
                the size is large enough. Application can also allocate buffer from this
                shared memory using SysInfo API.

        config ESP_AMP_SUBCORE_BUILD_TYPE_PURE_RTC_RAM_APP
            bool "Pure RTC RAM app"
            depends on ESP_AMP_SUBCORE_TYPE_LP_CORE
            default n
            help
                Use this if your subcore app is small enough and needs to run entirely
                from RTC memory (RTC memory is not affected by maincore light sleep).

                This option is a escape hatch for those who don't want to configure
                linker fragments with their light sleep enabled setup. Please refer
                to doc/light_sleep.md for more details.

        config ESP_AMP_SUBCORE_USE_HP_MEM_SIZE
            int "Maximum size of HP RAM to load subcore firmware"
            depends on !ESP_AMP_SUBCORE_BUILD_TYPE_PURE_RTC_RAM_APP
            default 16384 if IDF_TARGET_ESP32C6 || IDF_TARGET_ESP32C5
            default 65536 if IDF_TARGET_ESP32P4
            range 16384 49152 if IDF_TARGET_ESP32C6 || IDF_TARGET_ESP32C5
            range 65536 196608 if IDF_TARGET_ESP32P4
            help
                Configure the maximum size of HP RAM to load subcore firmware. Unused
                HP RAM will be given back to maincore heap automatically.

        config ESP_AMP_SUBCORE_STACK_SIZE_MIN
            int "Minimal stack size for subcore app"
            default 1024 if IDF_TARGET_ESP32C6 || IDF_TARGET_ESP32C5
            default 16384 if IDF_TARGET_ESP32P4
            range 256 32768
            help
                Configure the minimal size of stack space for subcore app. Stack is
                allocated from RTC RAM on ESP32-C5 and ESP32-C6 and HP RAM on ESP32-P4.
                This option serves as a lower bound for the stack size. If the remaining
                memory space is insufficient to allocate the stack, build will fail.

        config ESP_AMP_SUBCORE_ENABLE_HEAP
            bool "Enable dynamic memory management in subcore app"
            default "n"
            help
                Enable dynamic memory management in subcore app.

        config ESP_AMP_SUBCORE_HEAP_SIZE
            int "Size of heap for subcore app"
            depends on ESP_AMP_SUBCORE_ENABLE_HEAP
            default 512 if ((IDF_TARGET_ESP32C6 || IDF_TARGET_ESP32C5) && ESP_AMP_SUBCORE_BUILD_TYPE_PURE_RTC_RAM_APP)
            default 4096 if ((IDF_TARGET_ESP32C6 || IDF_TARGET_ESP32C5) && !ESP_AMP_SUBCORE_BUILD_TYPE_PURE_RTC_RAM_APP)
            default 16384 if IDF_TARGET_ESP32P4
            range 0 16384 if IDF_TARGET_ESP32C6 || IDF_TARGET_ESP32C5
            range 0 65536 if IDF_TARGET_ESP32P4
            help
                Configure the size of heap for subcore app.

    endmenu

    menu "ESP-AMP Subcore Toolchain Settings"
        depends on ESP_AMP_ENABLED

        config ESP_AMP_SUBCORE_ENABLE_HW_FPU
            bool "Enable and use hardware FPU for floating-point operations"
            depends on IDF_TARGET_ESP32P4
            default "y"
            help
                Enable the hardware FPU and use it for floating-point operations.
                If disabled or unsupported, then all floating-point operations will
                be performed using software FPU, which is significantly slower.

        config ESP_AMP_SUBCORE_ENABLE_HW_FPU_IN_ISR
            bool "Enable the use of hardware FPU in ISR context"
            depends on ESP_AMP_SUBCORE_ENABLE_HW_FPU
            default "n"
            help
                Enable this feature to support the floating-point operations in ISR context.
                Otherwise, hardware FPU is prohibited in ISR context and will trigger illegal
                instruction exception. This feature introduces considerable overhead for all
                ISR handlers, regardless floating-point operation is performed or not.

        config ESP_AMP_SUBCORE_USE_ARITH64
            bool "Use arith64 for 64-bit integer arithmetic"
            default "n"
            help
                Enable this feature to use arith64 project instead of libgcc for 64-bit integer
                arithmetic. This reduces subcore application code size by about 1 KB. For more
                details on code size and performance, please refer to the arith64 project here:
                https://github.com/glitchub/arith64.
    endmenu

    config ESP_AMP_EVENT_TABLE_LEN
        depends on ESP_AMP_ENABLED
        int "Number of OS-specific event handles ESP-AMP events can bind to (excluding reserved ones)"
        default 8
        range 4 64
        help
            Maximum number of OS-specific event handles ESP-AMP event is allowed to bind to.
            Bound to OS-provided event handles (e.g. EventGroupHandle in FreeRTOS) allows the
            task waiting on ESP-AMP events to be suspended by OS and resumed by OS when the
            event bits are set, instead of busy-waiting and checking the event bits in a loop.
            One event handle is reserved for each OS environment (Not the case in baremetal).
            This reserved event handle does not count towards this parameter.

    config ESP_AMP_SW_INTR_HANDLER_TABLE_LEN
        depends on ESP_AMP_ENABLED
        int "Number of software interrupt handlers"
        default 8
        range 4 64
        help
            Software interrupt handlers will be called when there is an incoming software
            interrupt triggered by another core. Multiple handlers can process a single
            interrupt. In the meantime, a single handler can process multiple interrupts.
            This parameter here defines the maximum number of handlers can be registered.

    menu "ESP-AMP System"
        depends on ESP_AMP_ENABLED

        config ESP_AMP_SYSTEM_ENABLE_SUPPLICANT
            bool "Enable ESP-AMP subcore supplicant"
            default "n"
            help
                Create a daemon task on maincore side to handle subcore requests, such as
                subcore console output delegation, subcore panic handling, etc. Subcore
                requests are sent to the daemon task via system-level virtqueue. This feature
                introduces about 2 KB flash footprint, 2.5 KB heap usage on maincore firmware
                and 2 KB consumption in shared memory region.

        config ESP_AMP_ROUTE_SUBCORE_PRINT
            bool "Route subcore print to maincore console via supplicant"
            depends on ESP_AMP_SYSTEM_ENABLE_SUPPLICANT
            select ULP_HP_UART_CONSOLE_PRINT if ESP_AMP_SUBCORE_TYPE_LP_CORE
            default "n"
            help
                Route subcore print to maincore console via subcore supplicant. This can solve
                the interleaved print problem that writing to UART0 directly may suffer from.
    endmenu
endmenu
```

## components/esp_amp/idf_stub/esp_pm/Kconfig
```kconfig
menu "Power Management"
    config PM_ENABLE
        bool "Support for power management"
        # SMP FreeRTOS currently does not support power management IDF-4997
        depends on (!FREERTOS_SMP && SOC_PM_SUPPORTED) || __DOXYGEN__
        default n
        help
            If enabled, application is compiled with support for power management.
            This option has run-time overhead (increased interrupt latency,
            longer time to enter idle state), and it also reduces accuracy of
            RTOS ticks and timers used for timekeeping.
            Enable this option if application uses power management APIs.
endmenu # "Power Management"
```

## examples/light_sleep/sdkconfig.defaults
```kconfig
CONFIG_ESP_AMP_ENABLED=y
CONFIG_ESPTOOLPY_FLASHSIZE_4MB=y

CONFIG_PARTITION_TABLE_CUSTOM=y
CONFIG_PARTITION_TABLE_CUSTOM_FILENAME="partitions.csv"
CONFIG_PARTITION_TABLE_FILENAME="partitions.csv"

CONFIG_ESP_AMP_SYSTEM_ENABLE_SUPPLICANT=y
CONFIG_ESP_AMP_ROUTE_SUBCORE_PRINT=y

CONFIG_PM_ENABLE=y
CONFIG_PM_LIGHT_SLEEP_CALLBACKS=y
CONFIG_FREERTOS_HZ=1000
CONFIG_FREERTOS_IDLE_TIME_BEFORE_SLEEP=3
CONFIG_ESP_AMP_SYSTEM_AUTO_LIGHT_SLEEP_SUPPORT_ENABLE=y
CONFIG_FREERTOS_USE_TICKLESS_IDLE=y
```

## examples/light_sleep/sdkconfig.defaults.esp32c5
```kconfig
# Enable LP Core
CONFIG_ULP_COPROC_ENABLED=y
CONFIG_ULP_COPROC_TYPE_LP_CORE=y
CONFIG_ULP_COPROC_RESERVE_MEM=14500
CONFIG_ULP_PANIC_OUTPUT_ENABLE=y

# LP Core Use HP MEM
CONFIG_ESP_AMP_HP_SHARED_MEM_SIZE=16384
CONFIG_ESP_AMP_SUBCORE_USE_HP_MEM_SIZE=16384
```

## examples/rpc/maincore_client_subcore_server/sdkconfig.defaults.esp32c5
```kconfig
CONFIG_ULP_COPROC_ENABLED=y
CONFIG_ULP_COPROC_TYPE_LP_CORE=y
CONFIG_ULP_COPROC_RESERVE_MEM=15000
CONFIG_ULP_PANIC_OUTPUT_ENABLE=y

CONFIG_ESP_AMP_SUBCORE_USE_HP_MEM_SIZE=16384
```

## test_apps/esp_amp_basic_tests/sdkconfig.defaults
```kconfig
CONFIG_ESP_AMP_ENABLED=y
CONFIG_ESPTOOLPY_FLASHSIZE_4MB=y

CONFIG_ESP_TASK_WDT=n
CONFIG_ESP_AMP_SYSTEM_ENABLE_SUPPLICANT=y
CONFIG_ESP_AMP_ROUTE_SUBCORE_PRINT=y
```

## test_apps/esp_amp_basic_tests/sdkconfig.defaults.esp32c6
```kconfig
# Enable LP Core
CONFIG_ULP_PANIC_OUTPUT_ENABLE=n
CONFIG_ULP_COPROC_ENABLED=y
CONFIG_ULP_COPROC_TYPE_LP_CORE=y
CONFIG_ULP_COPROC_RESERVE_MEM=14500

# LP Core Use HP MEM
CONFIG_ESP_AMP_SUBCORE_USE_HP_MEM_SIZE=49152

CONFIG_ESP_AMP_SUBCORE_ENABLE_HEAP=y
CONFIG_ESP_AMP_SUBCORE_HEAP_SIZE=4096
```

## test_apps/esp_amp_light_sleep_tests/sdkconfig.defaults
```kconfig
CONFIG_ESP_AMP_ENABLED=y
CONFIG_ESPTOOLPY_FLASHSIZE_4MB=y

CONFIG_ESP_TASK_WDT=n
CONFIG_ESP_AMP_SYSTEM_ENABLE_SUPPLICANT=y
CONFIG_ESP_AMP_ROUTE_SUBCORE_PRINT=y

CONFIG_ULP_PANIC_OUTPUT_ENABLE=n
CONFIG_ULP_COPROC_ENABLED=y
CONFIG_ULP_COPROC_TYPE_LP_CORE=y
CONFIG_ULP_COPROC_RESERVE_MEM=14500

CONFIG_ESP_AMP_SUBCORE_USE_HP_MEM_SIZE=49152
CONFIG_ESP_AMP_SUBCORE_ENABLE_HEAP=y
CONFIG_ESP_AMP_SUBCORE_HEAP_SIZE=4096

CONFIG_PM_ENABLE=y
CONFIG_PM_LIGHT_SLEEP_CALLBACKS=y
CONFIG_FREERTOS_HZ=1000
CONFIG_FREERTOS_IDLE_TIME_BEFORE_SLEEP=3
CONFIG_ESP_AMP_SYSTEM_AUTO_LIGHT_SLEEP_SUPPORT_ENABLE=y
CONFIG_FREERTOS_USE_TICKLESS_IDLE=y
```
